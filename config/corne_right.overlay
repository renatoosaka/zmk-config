#include "corne_tps43.dtsi"

&pro_micro_i2c {
    status = "okay";
    clock-frequency = <400000>;

    tps43: iqs5xx@74 {
        compatible = "azoteq,iqs5xx";
        status = "okay";
        reg = <0x74>;

        // D8 = P1.04; D9 = P1.06. Neither is used by the Corne matrix.
        rdy-gpios = <&pro_micro 8 GPIO_ACTIVE_HIGH>;
        reset-gpios = <&pro_micro 9 GPIO_ACTIVE_LOW>;

        // Match the horizontal direction verified on the installed TPS43.
        flip-x;

        one-finger-tap;
        two-finger-tap;
        press-and-hold;
        scroll;

        // Defaults are bottom-beta 5 and stationary-threshold 5.
        // Higher beta means less low-speed filtering. Raise toward 50 if still laggy.
        bottom-beta = <30>;
        stationary-threshold = <3>;
    };
};

&tps43_split {
    device = <&tps43>;
    // Runs on this half, before the event crosses the split.
    // Up/down were coming out as left/right, so swap first and then
    // invert the resulting X. The left listener must not transform
    // pointer axes again.
    input-processors = <&zip_xy_transform (INPUT_TRANSFORM_XY_SWAP | INPUT_TRANSFORM_X_INVERT)>;
};
