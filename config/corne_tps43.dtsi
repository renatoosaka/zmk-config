#include <dt-bindings/zmk/input_transform.h>
#include <input/processors/transform.dtsi>

/ {
    split_inputs {
        #address-cells = <1>;
        #size-cells = <0>;

        tps43_split: input_split@0 {
            compatible = "zmk,input-split";
            reg = <0>;
        };
    };

    tps43_listener: tps43_listener {
        compatible = "zmk,input-listener";
        status = "disabled";
        device = <&tps43_split>;
        // Physical test with flip-x only: pointer axes match the finger.
        // A swap plus X invert turned up into right and right into down.
        // This listener only swaps scroll.
        input-processors = <&zip_scroll_transform INPUT_TRANSFORM_XY_SWAP>;
    };
};
