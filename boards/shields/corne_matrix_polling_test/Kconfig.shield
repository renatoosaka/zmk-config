## boards/shields/corne_matrix_polling_test/Kconfig.shield
```kconfig
config SHIELD_CORNE_MATRIX_POLLING_TEST
    def_bool $(shields_list_contains,corne_matrix_polling_test)
```

## boards/shields/nicenano_matrix_output_test/Kconfig.defconfig
```kconfig
if SHIELD_NICENANO_MATRIX_OUTPUT_TEST

config ZMK_KEYBOARD_NAME
    default "GPIO Output Test"

config ZMK_BLE
    def_bool n

config SETTINGS
    def_bool n

endif
```

## boards/shields/nicenano_matrix_output_test/Kconfig.shield
```kconfig
config SHIELD_NICENANO_MATRIX_OUTPUT_TEST
    def_bool $(shields_list_contains,nicenano_matrix_output_test)
```
